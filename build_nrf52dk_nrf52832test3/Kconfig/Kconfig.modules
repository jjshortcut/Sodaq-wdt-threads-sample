## build_nrf52dk_nrf52832test3/Kconfig/Kconfig.modules
```kconfig
osource "C:/Users/jan-j/ncs/v1.4.1/nrf/Kconfig.nrf"

osource "C:/Users/jan-j/ncs/v1.4.1/bootloader/mcuboot/zephyr/Kconfig"

osource "C:/Users/jan-j/ncs/v1.4.1/nrfxlib/Kconfig.nrfxlib"
```

## build_nrf52dk_nrf52832test3/Kconfig/Kconfig.soc.arch
```kconfig
osource "C:/Users/jan-j/ncs/v1.4.1/zephyr/soc/$(ARCH)/Kconfig"
osource "C:/Users/jan-j/ncs/v1.4.1/zephyr/soc/$(ARCH)/*/Kconfig"
```
